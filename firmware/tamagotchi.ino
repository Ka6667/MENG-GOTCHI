// ── PIN DEFINITIONS ─────────────────────────────────────────
#define BTN_LEFT          D0
#define BTN_MIDDLE        D1
#define BTN_RIGHT         D2
#define BUZZER_PIN        D10
#define RED_LED_PIN       D6
#define GREEN_LED_PIN     D7
#define BLUE_LED_PIN      D8
#define TOUCH_SENSOR_PIN  D9

#include <Wire.h>
#include <Adafruit_GFX.h>
#include <Adafruit_SSD1306.h>

#define SCREEN_WIDTH  128
#define SCREEN_HEIGHT  64
#define OLED_RESET     -1

Adafruit_SSD1306 display(SCREEN_WIDTH, SCREEN_HEIGHT, &Wire, OLED_RESET);

struct Pet {
  int hunger;
  int happiness;
  int energy;
  int learning;
  int petting;
  unsigned long age;
};

Pet pet;

enum Screen {
  SCREEN_MAIN,
  SCREEN_FEED,
  SCREEN_PLAY,
  SCREEN_SLEEP,
  SCREEN_STUDY
};

Screen currentScreen    = SCREEN_MAIN;
Screen pendingFeedback  = SCREEN_MAIN;
bool   showFeedback     = false;
unsigned long feedbackStart = 0;

struct Word {
  const char* word;
  const char* definition;
};

const Word c2Words[] = {
  {"Ephemeral",     "Lasting a very short time"},
  {"Sycophant",     "A person who flatters for gain"},
  {"Loquacious",    "Excessively talkative"},
  {"Perspicuous",   "Clearly expressed; lucid"},
  {"Recondite",     "Little known; obscure"},
  {"Obfuscate",     "To make unclear or confusing"},
  {"Pellucid",      "Translucently clear"},
  {"Tendentious",   "Promoting a cause; biased"},
  {"Vituperate",    "To scold or criticize harshly"},
  {"Inveterate",    "Long-established; habitual"},
  {"Ameliorate",    "To make a bad situation better"},
  {"Cacophony",     "A harsh, discordant mixture of sounds"},
  {"Capricious",    "Given to sudden changes of mood"},
  {"Castigate",     "To reprimand someone severely"},
  {"Chicanery",     "The use of trickery to achieve a purpose"},
  {"Deleterious",   "Causing harm or damage"},
  {"Ebullient",     "Cheerful and full of energy"},
  {"Egregious",     "Outstandingly bad; shocking"},
  {"Enervate",      "To cause someone to feel drained"},
  {"Equivocate",    "To use ambiguous language"},
  {"Esoteric",      "Understood by only a few"},
  {"Fastidious",    "Very attentive to accuracy"},
  {"Grandiloquent", "Pompous in language or style"},
  {"Iconoclast",    "A person who attacks cherished beliefs"},
  {"Lugubrious",    "Profoundly sad and dismal"},
  {"Mellifluous",   "Sweet or musical; pleasant to hear"},
  {"Mendacious",    "Not telling the truth; lying"},
  {"Obdurate",      "Stubbornly refusing to change opinion"},
  {"Paucity",       "Presence of something in small quantity"},
  {"Perfidious",    "Deceitful and untrustworthy"},
  {"Pernicious",    "Harmful in a gradual, subtle way"},
  {"Pugnacious",    "Quick to argue or fight"},
  {"Quixotic",      "Exceedingly idealistic; impractical"},
  {"Recalcitrant",  "Obstinately uncooperative"},
  {"Sagacious",     "Showing keen mental discernment"},
  {"Alacrity",      "Brisk and cheerful readiness"},
  {"Anathema",      "Something one vehemently dislikes"},
  {"Blandishment",  "A flattering statement to persuade"},
  {"Calumny",       "Making false defamatory statements"},
  {"Desiccate",     "To remove moisture from something"},
  {"Encomium",      "A speech that praises someone highly"},
  {"Garrulous",     "Excessively talkative on trivial matters"},
  {"Inexorable",    "Impossible to stop or prevent"},
  {"Lachrymose",    "Tearful or given to weeping"},
  {"Nadir",         "The lowest point in one's fortunes"}
};

const int WORD_COUNT = 45;

// ── SPRITES ──────────────────────────────────────────────────

const unsigned char PROGMEM petHappy[] = {
  0xff, 0xff, 0xff, 0xff, 0xff, 0xff, 0xff, 0xff, 0xff, 0xff, 0xff, 0xff, 0xff, 0xff, 0xff, 0xff,
  0xff, 0xff, 0xff, 0xff, 0xff, 0xff, 0xff, 0xff, 0xff, 0xff, 0xff, 0xff, 0xff, 0xff, 0xff, 0xff,
  0xff, 0xff, 0xff, 0xff, 0xff, 0xff, 0xff, 0xff, 0xff, 0xff, 0xff, 0xff, 0xff, 0xff, 0xff, 0xff,
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  0xff, 0xff, 0xff, 0xff, 0xff, 0xff, 0xff, 0xff, 0xff, 0xff, 0xff, 0xff, 0xff, 0xff, 0xff, 0xff
};

const unsigned char PROGMEM petSad[] = {
  0xff, 0xff, 0xff, 0xff, 0xff, 0xff, 0xff, 0xff, 0xff, 0xff, 0xff, 0xff, 0xff, 0xff, 0xff, 0xff,
  0xff, 0xff, 0xff, 0xff, 0xff, 0xff, 0xff, 0xff, 0xff, 0xff, 0xff, 0xff, 0xff, 0xff, 0xff, 0xff,
  0xff, 0xff, 0xff, 0xff, 0xff, 0xff, 0xff, 0xff, 0xff, 0xff, 0xff, 0xff, 0xff, 0xff, 0xff, 0xff,
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  0xff, 0xff, 0xff, 0xff, 0xff, 0xff, 0xff, 0xff, 0xff, 0xff, 0xff, 0xff, 0xff, 0xff, 0xff, 0xff
};

const unsigned char PROGMEM petNeutral[] = {
  0xff, 0xff, 0xff, 0xff, 0xff, 0xff, 0xff, 0xff, 0xff, 0xff, 0xff, 0xff, 0xff, 0xff, 0xff, 0xff,
  0xff, 0xff, 0xff, 0xff, 0xff, 0xff, 0xff, 0xff, 0xff, 0xff, 0xff, 0xff, 0xff, 0xff, 0xff, 0xff,
  0xff, 0xff, 0xff, 0xff, 0xff, 0xff, 0xff, 0xff, 0xff, 0xff, 0xff, 0xff, 0xff, 0xff, 0xff, 0xff,
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  0xff, 0xff, 0xff, 0xff, 0xff, 0xff, 0xff, 0xff, 0xff, 0xff, 0xff, 0xff, 0xff, 0xff, 0xff, 0xff
};

const unsigned char PROGMEM petSleep[] = {
  0xff, 0xff, 0xff, 0xff, 0xff, 0xff, 0xff, 0xff, 0xff, 0xff, 0xff, 0xff, 0xff, 0xff, 0xff, 0xff,
  0xff, 0xff, 0xff, 0xff, 0xff, 0xff, 0xff, 0xff, 0xff, 0xff, 0xff, 0xff, 0xff, 0xff, 0xff, 0xff,
  0xff, 0xff, 0xff, 0xff, 0xff, 0xff, 0xff, 0xff, 0xff, 0xff, 0xff, 0xff, 0xff, 0xff, 0xff, 0xff,
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  0xff, 0xff, 0xff, 0xff, 0xff, 0xff, 0xff, 0xff, 0xff, 0xff, 0xff, 0xff, 0xff, 0xff, 0xff, 0xff
};

// ── HELPERS ───────────────────────────────────────────────────

int clamp(int v, int lo, int hi) {
  if (v < lo) return lo;
  if (v > hi) return hi;
  return v;
}

void drawBar(int x, int y, int value) {
  const int W = 56, H = 5;
  int fill = map(clamp(value, 0, 100), 0, 100, 0, W);
  display.drawRect(x, y, W, H, SSD1306_WHITE);
  if (fill > 0) display.fillRect(x, y, fill, H, SSD1306_WHITE);
}

void setLED(bool r, bool g, bool b) {
  digitalWrite(RED_LED_PIN,   r ? HIGH : LOW);
  digitalWrite(GREEN_LED_PIN, g ? HIGH : LOW);
  digitalWrite(BLUE_LED_PIN,  b ? HIGH : LOW);
}

// ── PETTING ───────────────────────────────────────────────────

void handlePetting() {
  static int           noteIndex    = 0;
  static unsigned long lastNoteTime = 0;
  static bool          playing      = false;

  const int melody[]    = {523, 659, 784};
  const int durations[] = { 80,  80, 120};
  const int pauses[]    = {100, 100, 140};

  bool touched = (digitalRead(TOUCH_SENSOR_PIN) == HIGH);

  if (touched && !playing) {
    playing      = true;
    noteIndex    = 0;
    tone(BUZZER_PIN, melody[0], durations[0]);
    lastNoteTime = millis();
    pet.petting   = clamp(pet.petting   + 20, 0, 100);
    pet.happiness = clamp(pet.happiness +  5, 0, 100);
  }

  if (playing && (millis() - lastNoteTime >= (unsigned long)pauses[noteIndex])) {
    noteIndex++;
    if (noteIndex < 3) {
      tone(BUZZER_PIN, melody[noteIndex], durations[noteIndex]);
      lastNoteTime = millis();
    } else {
      noTone(BUZZER_PIN);
      playing = false;
    }
  }
}

// ── STUDY ─────────────────────────────────────────────────────

void study() {
  int indices[5];
  int picked = 0;
  bool used[WORD_COUNT] = {};

  while (picked < 5) {
    int r = random(0, WORD_COUNT);
    if (!used[r]) { used[r] = true; indices[picked++] = r; }
  }

  for (int i = 0; i < 5; i++) {
    display.clearDisplay();
    display.setTextSize(1);
    display.setCursor(0, 0);
    display.print("Word ");
    display.print(i + 1);
    display.print("/5  [Mid]=Next");

    display.setCursor(0, 14);
    display.println(c2Words[indices[i]].word);

    display.setCursor(0, 26);
    display.println(c2Words[indices[i]].definition);

    // Show updated learning bar (reward applied after confirmation)
    display.setCursor(0, 50);
    display.print("LRN");
    drawBar(26, 50, pet.learning);

    display.display();

    while (digitalRead(BTN_MIDDLE) == LOW)  delay(10);
    while (digitalRead(BTN_MIDDLE) == HIGH) delay(10);
    while (digitalRead(BTN_MIDDLE) == LOW)  delay(10);

    pet.learning  = clamp(pet.learning  + 20, 0, 100);
    pet.happiness = clamp(pet.happiness +  3, 0, 100);
    pet.energy    = clamp(pet.energy    -  5, 0, 100);

    tone(BUZZER_PIN, 880,  80); delay(120);
    tone(BUZZER_PIN, 1047, 120); delay(150);
    noTone(BUZZER_PIN);
  }

  display.clearDisplay();
  display.setTextSize(1);
  display.setCursor(10, 20);
  display.println("Great job! LRN full!");
  display.setCursor(10, 36);
  display.println("Your pet is smarter!");
  display.display();

  int cel[]  = {523, 659, 784, 1047};
  int celD[] = { 80,  80,  80,  200};
  for (int n = 0; n < 4; n++) {
    tone(BUZZER_PIN, cel[n], celD[n]);
    delay(celD[n] + 30);
  }
  noTone(BUZZER_PIN);
  delay(1500);

  lastUpdate = millis();  // prevent instant decay tick after blocking study
  currentScreen = SCREEN_MAIN;
}

// ── SETUP ─────────────────────────────────────────────────────

unsigned long lastUpdate = 0;

void setup() {
  pinMode(BTN_LEFT,         INPUT_PULLUP);
  pinMode(BTN_MIDDLE,       INPUT_PULLUP);
  pinMode(BTN_RIGHT,        INPUT_PULLUP);
  pinMode(BUZZER_PIN,       OUTPUT);
  pinMode(RED_LED_PIN,      OUTPUT);
  pinMode(GREEN_LED_PIN,    OUTPUT);
  pinMode(BLUE_LED_PIN,     OUTPUT);
  pinMode(TOUCH_SENSOR_PIN, INPUT);

  if (!display.begin(SSD1306_SWITCHCAPVCC, 0x3C)) {
    while (true) {
      setLED(true, false, false); delay(300);
      setLED(false, false, false); delay(300);
    }
  }

  display.clearDisplay();
  display.setTextSize(1);
  display.setTextColor(SSD1306_WHITE);
  display.setCursor(24, 24);
  display.println("Tamagotchi booting..");
  display.display();
  delay(1200);

  pet.hunger    = 80;
  pet.happiness = 80;
  pet.energy    = 80;
  pet.learning  = 0;
  pet.petting   = 0;
  pet.age       = 0;

  randomSeed(esp_random());
}

// ── PASSIVE DECAY ─────────────────────────────────────────────

void updatePet() {
  if (millis() - lastUpdate < 5000) return;
  lastUpdate = millis();

  pet.hunger    = clamp(pet.hunger    - 1, 0, 100);
  pet.happiness = clamp(pet.happiness - 1, 0, 100);
  pet.energy    = clamp(pet.energy    - 1, 0, 100);
  pet.learning  = clamp(pet.learning  - 1, 0, 100);
  pet.petting   = clamp(pet.petting   - 2, 0, 100);
  pet.age      += 5;

  if (pet.hunger < 30 || pet.happiness < 30 || pet.energy < 30) {
    setLED(true, false, false);
  } else if (pet.hunger > 70 && pet.happiness > 70 && pet.energy > 70) {
    setLED(false, true, false);
  } else {
    setLED(false, false, true);
  }
}

// ── BUTTONS ───────────────────────────────────────────────────

unsigned long lastButtonPress = 0;

void checkButtons() {
  if (millis() - lastButtonPress < 200) return;

  if (digitalRead(BTN_LEFT) == LOW) {
    pet.hunger    = clamp(pet.hunger + 15, 0, 100);
    showFeedback  = true;
    pendingFeedback = SCREEN_FEED;
    feedbackStart = millis();
    lastButtonPress = millis();
    tone(BUZZER_PIN, 1000, 50);
  }
  else if (digitalRead(BTN_MIDDLE) == LOW) {
    pet.happiness = clamp(pet.happiness + 10, 0, 100);
    pet.energy    = clamp(pet.energy    -  5, 0, 100);
    showFeedback  = true;
    pendingFeedback = SCREEN_PLAY;
    feedbackStart = millis();
    lastButtonPress = millis();
    tone(BUZZER_PIN, 1200, 50);
  }
  else if (digitalRead(BTN_RIGHT) == LOW) {
    unsigned long pressStart = millis();
    while (digitalRead(BTN_RIGHT) == LOW) delay(10);
    unsigned long held = millis() - pressStart;

    if (held >= 600) {
      currentScreen = SCREEN_STUDY;
      tone(BUZZER_PIN, 600, 80); delay(100);
      tone(BUZZER_PIN, 800, 80);
    } else {
      pet.energy  = clamp(pet.energy + 20, 0, 100);
      showFeedback = true;
      pendingFeedback = SCREEN_SLEEP;
      feedbackStart = millis();
      tone(BUZZER_PIN, 800, 50);
    }
    lastButtonPress = millis();
  }
}

// ── RENDER ────────────────────────────────────────────────────

void render() {
  display.clearDisplay();

  // Show a brief action label for Feed / Play / Sleep
  if (showFeedback) {
    display.setTextSize(2);
    display.setCursor(20, 22);
    if      (pendingFeedback == SCREEN_FEED)  display.print("Feeding!");
    else if (pendingFeedback == SCREEN_PLAY)  display.print("Playing!");
    else if (pendingFeedback == SCREEN_SLEEP) display.print("Sleeping!");
    display.display();
    if (millis() - feedbackStart >= 800) showFeedback = false;
    return;
  }

  // Choose sprite
  const unsigned char* sprite;
  if (currentScreen == SCREEN_SLEEP ||
      (pet.energy < 20 && pet.hunger > 30 && pet.happiness > 30)) {
    sprite = petSleep;
  } else if (pet.hunger < 30 || pet.happiness < 30 || pet.energy < 30) {
    sprite = petSad;
  } else if (pet.hunger > 60 && pet.happiness > 60 && pet.energy > 60) {
    sprite = petHappy;
  } else {
    sprite = petNeutral;
  }

  display.drawBitmap(0, 0, sprite, 128, 64, SSD1306_WHITE);
  display.fillRect(68, 0, 60, 64, SSD1306_BLACK);

  display.setTextSize(1);

  // 5 stat bars in right panel
  display.setCursor(69, 0);  display.print("HUN");
  drawBar(69, 8,  pet.hunger);

  display.setCursor(69, 16); display.print("HAP");
  drawBar(69, 24, pet.happiness);

  display.setCursor(69, 32); display.print("ENG");
  drawBar(69, 40, pet.energy);

  display.setCursor(69, 48); display.print("LRN");
  drawBar(69, 56, pet.learning);

  // Age in minutes shown as tiny text under the sprite
  display.setCursor(0, 57);
  display.print("Age:");
  display.print(pet.age / 60);
  display.print("m");

  display.display();
}

// ── LOOP ──────────────────────────────────────────────────────

void loop() {
  checkButtons();
  handlePetting();
  updatePet();

  if (currentScreen == SCREEN_STUDY) {
    study();
  }

  render();
  delay(100);
}
