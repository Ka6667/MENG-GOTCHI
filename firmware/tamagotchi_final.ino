
// ── PIN DEFINITIONS ─────────────────────────────────────────
#define BTN_LEFT          D0   // SW1 (INPUT_PULLUP → LOW when pressed)
#define BTN_MIDDLE        D1   // SW2
#define BTN_RIGHT         D2   // SW3
#define BUZZER_PIN        D10  // Buzzer OUTPUT
#define RED_LED_PIN       D6   // RGB Red   OUTPUT
#define GREEN_LED_PIN     D7   // RGB Green OUTPUT
#define BLUE_LED_PIN      D8   // RGB Blue  OUTPUT
#define TOUCH_SENSOR_PIN  D9   // Touch sensor INPUT (HIGH when touched)

// ── LIBRARIES ───────────────────────────────────────────────
#include <Wire.h>
#include <Adafruit_GFX.h>
#include <Adafruit_SSD1306.h>

// ── DISPLAY ─────────────────────────────────────────────────
#define SCREEN_WIDTH  128
#define SCREEN_HEIGHT  64
#define OLED_RESET     -1
Adafruit_SSD1306 display(SCREEN_WIDTH, SCREEN_HEIGHT, &Wire, OLED_RESET);

// ============================================================
//  PET MODEL
// ============================================================
struct Pet {
  int hunger;        // 0–100  (0 = starving,    100 = full)
  int happiness;     // 0–100  (0 = miserable,   100 = ecstatic)
  int energy;        // 0–100  (0 = exhausted,   100 = fully rested)
  int learning;      // 0–100  (tracks study progress this cycle)
  int petting;       // 0–100  (fades without touch)
  unsigned long age; // seconds alive (increments every 5 s tick)
};
Pet pet;

// ============================================================
//  UI STATE MACHINE
// ============================================================
enum Screen {
  SCREEN_MAIN,
  SCREEN_FEED,
  SCREEN_PLAY,
  SCREEN_SLEEP,
  SCREEN_STUDY
};
Screen currentScreen = SCREEN_MAIN;

// ============================================================
//  C2 WORD BANK — 45 words, sequential cycling
// ============================================================
struct Word {
  const char* word;
  const char* definition;
};

const Word c2Words[] = {
  {"Ephemeral",     "Lasting a very short time"},
  {"Sycophant",     "One who flatters for gain"},
  {"Loquacious",    "Excessively talkative"},
  {"Perspicuous",   "Clearly expressed; lucid"},
  {"Recondite",     "Little known; obscure"},
  {"Obfuscate",     "Make unclear or confusing"},
  {"Pellucid",      "Translucently clear"},
  {"Tendentious",   "Promoting a cause; biased"},
  {"Vituperate",    "Scold or criticise harshly"},
  {"Inveterate",    "Long-established; habitual"},
  {"Ameliorate",    "Make a bad situation better"},
  {"Cacophony",     "Harsh discordant mixture of sounds"},
  {"Capricious",    "Given to sudden mood changes"},
  {"Castigate",     "Reprimand someone severely"},
  {"Chicanery",     "Use of trickery to achieve goal"},
  {"Deleterious",   "Causing harm or damage"},
  {"Ebullient",     "Cheerful and full of energy"},
  {"Egregious",     "Outstandingly bad; shocking"},
  {"Enervate",      "Cause someone to feel drained"},
  {"Equivocate",    "Use vague language to deceive"},
  {"Esoteric",      "Known only by a small group"},
  {"Fastidious",    "Very attentive to detail"},
  {"Grandiloquent", "Pompous or extravagant language"},
  {"Iconoclast",    "One who attacks cherished beliefs"},
  {"Lugubrious",    "Profoundly sad and dismal"},
  {"Mellifluous",   "Sweet or musical in sound"},
  {"Mendacious",    "Not telling the truth; lying"},
  {"Obdurate",      "Stubbornly refusing to change"},
  {"Paucity",       "Presence of something insufficient"},
  {"Perfidious",    "Deceitful and untrustworthy"},
  {"Pernicious",    "Harmful in a gradual subtle way"},
  {"Pugnacious",    "Quick to argue or fight"},
  {"Quixotic",      "Exceedingly idealistic"},
  {"Recalcitrant",  "Stubbornly uncooperative"},
  {"Sagacious",     "Showing keen mental discernment"},
  {"Alacrity",      "Brisk and cheerful readiness"},
  {"Anathema",      "Something one vehemently dislikes"},
  {"Blandishment",  "Flattery used to persuade"},
  {"Calumny",       "Making false defamatory statements"},
  {"Desiccate",     "Remove moisture from something"},
  {"Encomium",      "A speech of high praise"},
  {"Garrulous",     "Excessively talkative on trivia"},
  {"Inexorable",    "Impossible to stop or prevent"},
  {"Lachrymose",    "Tearful or given to weeping"},
  {"Nadir",         "The lowest point of a situation"}
};

const int WORD_COUNT = 45;

// Sequential word tracking — persists across study sessions
int currentWordIndex = 0;
int cyclesCompleted  = 0;

// ============================================================
//  SPRITES  (128×64, 1-bit, PROGMEM)
// ============================================================

const unsigned char PROGMEM petHappy[] = {
  0xff, 0xff, 0xff, 0xff, 0xff, 0xff, 0xff, 0xff, 0xff, 0xff, 0xff, 0xff, 0xff, 0xff, 0xff, 0xff,
  0xff, 0xff, 0xff, 0xff, 0xff, 0xff, 0xff, 0xff, 0xff, 0xff, 0xff, 0xff, 0xff, 0xff, 0xff, 0xff,
  0xff, 0xff, 0xff, 0xff, 0xff, 0xff, 0xff, 0xff, 0xff, 0xff, 0xff, 0xff, 0xff, 0xff, 0xff, 0xff,
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  0xff, 0xff, 0xff, 0xff, 0xff, 0xff, 0xff, 0xff, 0xff, 0xff, 0xff, 0xff, 0xff, 0xff, 0xff, 0xff
};

const unsigned char PROGMEM petSad[] = {
  0xff, 0xff, 0xff, 0xff, 0xff, 0xff, 0xff, 0xff, 0xff, 0xff, 0xff, 0xff, 0xff, 0xff, 0xff, 0xff,
  0xff, 0xff, 0xff, 0xff, 0xff, 0xff, 0xff, 0xff, 0xff, 0xff, 0xff, 0xff, 0xff, 0xff, 0xff, 0xff,
  0xff, 0xff, 0xff, 0xff, 0xff, 0xff, 0xff, 0xff, 0xff, 0xff, 0xff, 0xff, 0xff, 0xff, 0xff, 0xff,
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  0xff, 0xff, 0xff, 0xff, 0xff, 0xff, 0xff, 0xff, 0xff, 0xff, 0xff, 0xff, 0xff, 0xff, 0xff, 0xff
};

const unsigned char PROGMEM petNeutral[] = {
  0xff, 0xff, 0xff, 0xff, 0xff, 0xff, 0xff, 0xff, 0xff, 0xff, 0xff, 0xff, 0xff, 0xff, 0xff, 0xff,
  0xff, 0xff, 0xff, 0xff, 0xff, 0xff, 0xff, 0xff, 0xff, 0xff, 0xff, 0xff, 0xff, 0xff, 0xff, 0xff,
  0xff, 0xff, 0xff, 0xff, 0xff, 0xff, 0xff, 0xff, 0xff, 0xff, 0xff, 0xff, 0xff, 0xff, 0xff, 0xff,
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  0xff, 0xff, 0xff, 0xff, 0xff, 0xff, 0xff, 0xff, 0xff, 0xff, 0xff, 0xff, 0xff, 0xff, 0xff, 0xff
};

const unsigned char PROGMEM petSleep[] = {
  0xff, 0xff, 0xff, 0xff, 0xff, 0xff, 0xff, 0xff, 0xff, 0xff, 0xff, 0xff, 0xff, 0xff, 0xff, 0xff,
  0xff, 0xff, 0xff, 0xff, 0xff, 0xff, 0xff, 0xff, 0xff, 0xff, 0xff, 0xff, 0xff, 0xff, 0xff, 0xff,
  0xff, 0xff, 0xff, 0xff, 0xff, 0xff, 0xff, 0xff, 0xff, 0xff, 0xff, 0xff, 0xff, 0xff, 0xff, 0xff,
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  0xff, 0xff, 0xff, 0xff, 0xff, 0xff, 0xff, 0xff, 0xff, 0xff, 0xff, 0xff, 0xff, 0xff, 0xff, 0xff
};

// ============================================================
//  HELPERS
// ============================================================

int clamp(int v, int lo, int hi) {
  if (v < lo) return lo;
  if (v > hi) return hi;
  return v;
}

// Stat bar: fits inside the right-side panel (x=68 to x=127 = 59px wide)
// barWidth = 50 keeps a small margin
void drawBar(int x, int y, int value) {
  const int barWidth  = 50;
  const int barHeight = 5;
  int fillWidth = map(value, 0, 100, 0, barWidth);
  display.drawRect(x, y, barWidth, barHeight, SSD1306_WHITE);
  if (fillWidth > 0)
    display.fillRect(x, y, fillWidth, barHeight, SSD1306_WHITE);
}

void setLED(bool r, bool g, bool b) {
  digitalWrite(RED_LED_PIN,   r ? HIGH : LOW);
  digitalWrite(GREEN_LED_PIN, g ? HIGH : LOW);
  digitalWrite(BLUE_LED_PIN,  b ? HIGH : LOW);
}

// Wait for MIDDLE button: release if held → wait press → wait release
void waitMiddle() {
  while (digitalRead(BTN_MIDDLE) == LOW)  delay(10);
  while (digitalRead(BTN_MIDDLE) == HIGH) delay(10);
  while (digitalRead(BTN_MIDDLE) == LOW)  delay(10);
}

void confirmBeep() {
  tone(BUZZER_PIN, 880,  80); delay(120);
  tone(BUZZER_PIN, 1047, 100); delay(130);
  noTone(BUZZER_PIN);
}
void handlePetting() {
  static int           noteIndex    = 0;
  static unsigned long lastNoteTime = 0;
  static bool          playing      = false;

  const int melody[]    = {523, 659, 784};
  const int durations[] = { 80,  80, 120};
  const int pauses[]    = {100, 100, 140};

  bool touched = (digitalRead(TOUCH_SENSOR_PIN) == HIGH);

  if (touched && !playing) {
    playing      = true;
    noteIndex    = 0;
    lastNoteTime = millis();
    tone(BUZZER_PIN, melody[0], durations[0]);
    pet.petting   = clamp(pet.petting   + 20, 0, 100);
    pet.happiness = clamp(pet.happiness +  5, 0, 100);
  }

  if (playing && (millis() - lastNoteTime >= (unsigned long)pauses[noteIndex])) {
    noteIndex++;
    if (noteIndex < 3) {
      tone(BUZZER_PIN, melody[noteIndex], durations[noteIndex]);
      lastNoteTime = millis();
    } else {
      noTone(BUZZER_PIN);
      playing = false;
    }
  }
}

// ============================================================
//  STUDY  — sequential, 5 words per session, cycles all 45
// ============================================================
void study() {

  for (int i = 0; i < 5; i++) {

    // ── Cycle-complete banner (only at the very start of a new cycle) ──
    if (currentWordIndex == 0 && i == 0 && cyclesCompleted > 0) {
      display.clearDisplay();
      display.setTextSize(1);
      display.setCursor(0, 4);
      display.println("You've learned all");
      display.println("45 words!");
      display.print("Cycles done: ");
      display.println(cyclesCompleted);
      display.setCursor(0, 46);
      display.println("Starting over...");
      display.setCursor(0, 56);
      display.println("[Middle] to continue");
      display.display();

      // Celebration melody
      int cel[]  = {523, 659, 784, 1047, 1319};
      int celD[] = { 80,  80,  80,  120,  200};
      for (int n = 0; n < 5; n++) {
        tone(BUZZER_PIN, cel[n], celD[n]);
        delay(celD[n] + 30);
      }
      noTone(BUZZER_PIN);
      waitMiddle();
    }

    // ── Show word ─────────────────────────────────────────────────────
    display.clearDisplay();
    display.setTextSize(1);

    // Line 0 — header
    display.setCursor(0, 0);
    display.print('#');
    display.print(currentWordIndex + 1);
    display.print("/45  ");
    display.print(i + 1);
    display.print("/5  Cyc:");
    display.print(cyclesCompleted + 1);

    // Line 1 — word (slightly larger)
    display.setTextSize(1);
    display.setCursor(0, 14);
    display.println(c2Words[currentWordIndex].word);

    // Lines 2-3 — definition (may wrap)
    display.setCursor(0, 26);
    display.println(c2Words[currentWordIndex].definition);

    // Progress bar across all 45 words
    display.setCursor(0, 48);
    display.print("Prog:");
    {
      int fill = map(currentWordIndex, 0, WORD_COUNT - 1, 0, 88);
      display.drawRect(30, 49, 88, 5, SSD1306_WHITE);
      if (fill > 0) display.fillRect(30, 49, fill, 5, SSD1306_WHITE);
    }

    display.setCursor(0, 57);
    display.print("[Mid]=Got it");
    display.display();

    // ── Wait for confirm ──────────────────────────────────────────────
    waitMiddle();

    // ── Reward ───────────────────────────────────────────────────────
    pet.learning  = clamp(pet.learning  + 2, 0, 100);
    pet.happiness = clamp(pet.happiness + 2, 0, 100);
    pet.energy    = clamp(pet.energy    - 3, 0, 100);

    confirmBeep();

    // ── Advance index ────────────────────────────────────────────────
    currentWordIndex++;
    if (currentWordIndex >= WORD_COUNT) {
      currentWordIndex = 0;
      cyclesCompleted++;
    }
  }

  // ── Session summary ───────────────────────────────────────────────
  display.clearDisplay();
  display.setTextSize(1);
  display.setCursor(0, 8);
  display.println("Session done!");
  display.setCursor(0, 22);
  display.print("Next word : #");
  display.println(currentWordIndex + 1);
  display.setCursor(0, 34);
  display.print("Cycles    : ");
  display.println(cyclesCompleted);
  display.setCursor(0, 48);
  display.println("Keep it up!");
  display.display();
  delay(2000);

  currentScreen = SCREEN_MAIN;
}

// ============================================================
//  SETUP
// ============================================================
void setup() {
  pinMode(BTN_LEFT,         INPUT_PULLUP);
  pinMode(BTN_MIDDLE,       INPUT_PULLUP);
  pinMode(BTN_RIGHT,        INPUT_PULLUP);
  pinMode(BUZZER_PIN,       OUTPUT);
  pinMode(RED_LED_PIN,      OUTPUT);
  pinMode(GREEN_LED_PIN,    OUTPUT);
  pinMode(BLUE_LED_PIN,     OUTPUT);
  pinMode(TOUCH_SENSOR_PIN, INPUT);

  // OLED init — flash red forever if it fails
  if (!display.begin(SSD1306_SWITCHCAPVCC, 0x3C)) {
    while (true) {
      setLED(true, false, false); delay(300);
      setLED(false, false, false); delay(300);
    }
  }

  display.clearDisplay();
  display.setTextSize(1);
  display.setTextColor(SSD1306_WHITE);
  display.setCursor(0, 24);
  display.println("Tamagotchi booting..");
  display.display();
  delay(1200);

  // Initialise pet
  pet.hunger    = 80;
  pet.happiness = 80;
  pet.energy    = 80;
  pet.learning  =  0;
  pet.petting   =  0;
  pet.age       =  0;

  randomSeed(analogRead(26)); // GP26 = safe floating analog pin on Pico
}

// ============================================================
//  PASSIVE DECAY  (every 5 s)
// ============================================================
unsigned long lastUpdate = 0;

void updatePet() {
  if (millis() - lastUpdate < 5000) return;
  lastUpdate = millis();

  pet.hunger    = clamp(pet.hunger    - 1, 0, 100);
  pet.happiness = clamp(pet.happiness - 1, 0, 100);
  pet.energy    = clamp(pet.energy    - 1, 0, 100);
  pet.learning  = clamp(pet.learning  - 1, 0, 100);
  pet.petting   = clamp(pet.petting   - 2, 0, 100);
  pet.age      += 5;

  // RGB LED reflects mood
  if (pet.hunger < 30 || pet.happiness < 30 || pet.energy < 30) {
    setLED(true,  false, false); // red   = struggling
  } else if (pet.hunger > 70 && pet.happiness > 70 && pet.energy > 70) {
    setLED(false, true,  false); // green = thriving
  } else {
    setLED(false, false, true ); // blue  = okay
  }
}

// ============================================================
//  BUTTON INPUT  (debounced; long-press RIGHT ≥ 600ms = study)
// ============================================================
unsigned long lastButtonPress = 0;

void checkButtons() {
  if (millis() - lastButtonPress < 200) return;

  if (digitalRead(BTN_LEFT) == LOW) {
    currentScreen   = SCREEN_FEED;
    lastButtonPress = millis();
    tone(BUZZER_PIN, 1000, 50);
  }
  else if (digitalRead(BTN_MIDDLE) == LOW) {
    currentScreen   = SCREEN_PLAY;
    lastButtonPress = millis();
    tone(BUZZER_PIN, 1200, 50);
  }
  else if (digitalRead(BTN_RIGHT) == LOW) {
    unsigned long t = millis();
    while (digitalRead(BTN_RIGHT) == LOW) delay(10);
    unsigned long held = millis() - t;

    if (held >= 600) {
      currentScreen = SCREEN_STUDY;
      tone(BUZZER_PIN, 600, 80); delay(110);
      tone(BUZZER_PIN, 800, 80); delay(90);
      noTone(BUZZER_PIN);
    } else {
      currentScreen = SCREEN_SLEEP;
      tone(BUZZER_PIN, 800, 50);
    }
    lastButtonPress = millis();
  }
}

// ============================================================
//  SCREEN ACTIONS
// ============================================================
void handleScreenLogic() {
  switch (currentScreen) {

    case SCREEN_FEED:
      pet.hunger = clamp(pet.hunger + 15, 0, 100);
      currentScreen = SCREEN_MAIN;
      break;

    case SCREEN_PLAY:
      pet.happiness = clamp(pet.happiness + 10, 0, 100);
      pet.energy    = clamp(pet.energy    -  5, 0, 100);
      currentScreen = SCREEN_MAIN;
      break;

    case SCREEN_SLEEP:
      pet.energy = clamp(pet.energy + 20, 0, 100);
      currentScreen = SCREEN_MAIN;
      break;

    case SCREEN_STUDY:
      study(); // study() sets currentScreen = SCREEN_MAIN when done
      break;

    case SCREEN_MAIN:
    default:
      break;
  }
}

// ============================================================
//  RENDER  (skipped while study() owns the display)
// ============================================================
void render() {
  if (currentScreen == SCREEN_STUDY) return;

  display.clearDisplay();

  // ── Choose sprite ────────────────────────────────────────
  const unsigned char* sprite;
  bool lowEnergy = (pet.energy < 20 && pet.hunger > 30 && pet.happiness > 30);
  if (currentScreen == SCREEN_SLEEP || lowEnergy) {
    sprite = petSleep;
  } else if (pet.hunger < 30 || pet.happiness < 30 || pet.energy < 30) {
    sprite = petSad;
  } else if (pet.hunger > 60 && pet.happiness > 60 && pet.energy > 60) {
    sprite = petHappy;
  } else {
    sprite = petNeutral;
  }

  // Full 128×64 sprite
  display.drawBitmap(0, 0, sprite, 128, 64, SSD1306_WHITE);

  // ── Right-side stat panel (x 68..127 = 59 px wide) ───────
  // Black out panel so sprite doesn't bleed through text
  display.fillRect(67, 0, 61, 64, SSD1306_BLACK);

  display.setTextSize(1);

  // HUN bar  — label at x68, bar starts at x68+4=72... but
  // label is 3 chars × 6px = 18px, so bar starts at x=87
  display.setCursor(68, 1);  display.print("HUN");
  drawBar(68, 9, pet.hunger);

  display.setCursor(68, 18); display.print("HAP");
  drawBar(68, 26, pet.happiness);

  display.setCursor(68, 35); display.print("ENG");
  drawBar(68, 43, pet.energy);

  // Age in minutes
  display.setCursor(68, 54);
  display.print(pet.age / 60);
  display.print("min");

  display.display();
}

// ============================================================
//  MAIN LOOP
// ============================================================
void loop() {
  checkButtons();      // 1. Read buttons
  handlePetting();     // 2. Touch sensor (non-blocking)
  updatePet();         // 3. Passive decay every 5 s
  handleScreenLogic(); // 4. Execute screen action
  render();            // 5. Draw display
  delay(100);          // 6. ~10 fps
}
